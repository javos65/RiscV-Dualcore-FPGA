# LFD2NX_40 register map
Vendor: Latticsemi.com; Series: LFD2NX; File version: 1.0
DualCore
Registers are 32-bit, read-write, reset 0x0 unless marked. A register's access mark holds for its fields unless they carry their own. Offsets are from the block's base; lines under a group give offsets from that group; [hi:lo] are bit positions; {n}, {i} and the like mark numbered series; 'fields as' and 'values as' point back to an identical list; <NAME> marks a mode.

## Memory map
0x00000000 sysmem1_inst size 0x8000
0x00008800 dualport_inst size 0x800
0x00008800 gpio1_inst size 0x400
0xFFFF0000 cpu1_inst size 0x800

## cpu1_inst
Base 0xFFFF0000
0x00 PIC_STATUS 2-bit — Interrupt Status Register
  [1:0] status — Interrupt Status
0x04 PIC_ENABLE 2-bit — Interrupt Enable Register
  [1:0] enable — Interrupt Enable
0x08 PIC_SET 2-bit wo — Interrupt Set Register
  [1:0] set — Interrupt Set
0x0C PIC_POL 2-bit — Interrupt Polarity Register
  [1:0] pol — Interrupt Polarity
0x400 TIMER_CNT_L — Timer Counter Lower Register
  [31:0] cnt_l — Lower 32 bits of 64-bit timer counter register
0x404 TIMER_CNT_H — Timer Counter Higher Register
  [31:0] cnt_h — Higher 32 bits of 64-bit timer counter register
0x410 TIMER_CMP_L — Timer Compare Lower Register
  [31:0] cmp_l — Lower 32 bits of 64-bit timer compare register
0x414 TIMER_CMP_H — Timer Compare Higher Register
  [31:0] cmp_h — Higher 32 bits of 64-bit timer compare register

## gpio1_inst
Base 0x00008800
0x00 RD_DATA_REG ro — Read Data Register
  [7:0] rd_data — Read actual values of GPIO's
0x04 WR_DATA_REG — Write Data Register
  [7:0] wr_data — Write GPIO output register
0x08 SET_DATA_REG wo — Set Data Register
  [7:0] set_data — Set GPIO output register
0x0C CLEAR_DATA_REG wo — Clear Data Register
  [7:0] clear_data — Clear GPIO output register
0x10 DIRECTION_REG — Direction Register
  [7:0] direction_reg — GPIO Direction register
0x14 INT_TYPE_REG — Interrupt Type Register
  [7:0] int_type — Interrupt Type Cofiguration Register, 1-Edge, 0-Level
0x18 INT_METHOD_REG — Interrupt Method Register
  [7:0] int_method — Interrupt Method Register, if Interrupt Type is Edge` 1-Rising edge 0-faling edge, if Interrupt Type is Level` 1-High level, 0-Low level
0x1C INT_STATUS_REG — Interrupt Status Register
  [7:0] int_status — Interrupt Status Register, indicates interrupt status
0x20 INT_ENABLE_REG — Interrupt Enable Register
  [7:0] Int_enable — Interrupt Enable Register, enables appropriate channel interrupt
0x24 INT_SET_REG wo — Interrupt Set Register
  [7:0] int_set — Interrupt Set Register, user can generate interrupt by writing '1' to the corresponding bit of this register
